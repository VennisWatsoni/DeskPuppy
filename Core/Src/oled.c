#include "stm32f1xx_hal.h"
#include "oled.h"

static void SoftSPI_Delay_us(uint32_t t)
{
	uint32_t i;
	while(t--)
		for(i=0;i<36;i++);
}

//软件SPI发送1字节
void OLED_Write_Byte(uint8_t dat)
{
	uint8_t i;
	for(i=0;i<8;i++)
	{
		OLED_SCL_LOW();
		if(dat & 0x80)
			OLED_SDA_HIGH();
		else
			OLED_SDA_LOW();
		dat <<=1;
		SoftSPI_Delay_us(1);
		OLED_SCL_HIGH();
		SoftSPI_Delay_us(1);
	}
}

//写命令 DC=0
void OLED_Write_Cmd(uint8_t cmd)
{
	OLED_DC_LOW();
	OLED_Write_Byte(cmd);
}

//写数据 DC=1
void OLED_Write_Data(uint8_t data)
{
	OLED_DC_HIGH();
	OLED_Write_Byte(data);
}

void OLED_Init(void)
{
	//RES复位时序
	OLED_RES_HIGH();
	HAL_Delay(20);
	OLED_RES_LOW();
	HAL_Delay(20);
	OLED_RES_HIGH();

	OLED_Write_Cmd(0xAE); //关闭显示
	OLED_Write_Cmd(0xD5);
	OLED_Write_Cmd(0x80);
	OLED_Write_Cmd(0xA8);
	OLED_Write_Cmd(0x3F);
	OLED_Write_Cmd(0xD3);
	OLED_Write_Cmd(0x00);
	OLED_Write_Cmd(0x40);
	OLED_Write_Cmd(0xA1); //段映射
	OLED_Write_Cmd(0xC8);
	OLED_Write_Cmd(0xDA);
	OLED_Write_Cmd(0x12);
	OLED_Write_Cmd(0x81);
	OLED_Write_Cmd(0xCF);
	OLED_Write_Cmd(0xD9);
	OLED_Write_Cmd(0xF1);
	OLED_Write_Cmd(0xDB);
	OLED_Write_Cmd(0x30);
	OLED_Write_Cmd(0xA4);
	OLED_Write_Cmd(0xA6);
	OLED_Write_Cmd(0x8D);
	OLED_Write_Cmd(0x14); //电荷泵开启，3.3V供电
	OLED_Write_Cmd(0xAF); //开显示
	OLED_Clear();
}

void OLED_Clear(void)
{
	uint8_t y,x;
	for(y=0;y<8;y++)
	{
		OLED_Write_Cmd(0xb0+y);
		OLED_Write_Cmd(0x00);
		OLED_Write_Cmd(0x10);
		for(x=0;x<128;x++)
			OLED_Write_Data(0x00);
	}
}

void OLED_SetPos(uint8_t x,uint8_t y)
{
	OLED_Write_Cmd(0xb0+y);
	OLED_Write_Cmd(((x&0xf0)>>4)|0x10);
	OLED_Write_Cmd(x&0x0f);
}

//oled.c
const unsigned char F8X16[95][16] =
{
{0x00,0x00,0x00,0x00,0x00,0x00,0x00,0x00,0x00,0x00,0x00,0x00,0x00,0x00,0x00,0x00},/*" ",0*/
{0x00,0x00,0x00,0xF8,0x00,0x00,0x00,0x00,0x00,0x00,0x00,0x33,0x00,0x00,0x00,0x00},/*"!",1*/
{0x00,0x10,0x0C,0x02,0x10,0x0C,0x02,0x00,0x00,0x00,0x00,0x00,0x00,0x00,0x00,0x00},/*""",2*/
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{0x00,0x02,0x01,0x02,0x02,0x04,0x02,0x00,0x00,0x00,0x00,0x00,0x00,0x00,0x00,0x00},/*"~",94*/
};

const uint8_t face_img[] = {
0x00,0x00,0x00,0x00,0x00,0x00,0x00,0x00,0x00,0x00,0x00,0x00,0x00,0x00,0x00,0x00,
0x00,0x00,0x00,0x00,0x00,0x00,0x00,0x00,0x00,0x00,0x00,0x00,0x00,0x00,0x00,0x00,
0x00,0x00,0x00,0x00,0x00,0x00,0x00,0x00,0x00,0x00,0x00,0x00,0x00,0x00,0x00,0x00,
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0x00,0x00,0x00,0x00,0x00,0x00,0x00,0x00,0x00,0x00,0x00,0x00,0x00,0x00,0x00,0x00,
};
void OLED_ShowChar(uint8_t x,uint8_t y,char ch)
{
    uint8_t i;
    // 越界保护，只支持32~126可打印ASCII
    if(ch < 32 || ch > 126) return;
    uint8_t idx = ch - 32;
    OLED_SetPos(x,y);
    for(i=0;i<8;i++)
    {
        OLED_Write_Data(F8X16[idx][i]);
    }
    OLED_SetPos(x,y+1);
    for(i=0;i<8;i++)
    {
        OLED_Write_Data(F8X16[idx][i+8]);
    }
}

void OLED_ShowString(uint8_t x,uint8_t y,char *str)
{
    while(*str != '\0')
    {
        OLED_ShowChar(x,y,*str);
        x += 8;
        str++;
    }
}
void OLED_DrawFullImage(const uint8_t *img)
{
    uint8_t page,x;
    for(page=0;page<8;page++)
    {
        OLED_SetPos(0, page);
        for(x=0;x<128;x++)
        {
            OLED_Write_Data(*img++);
        }
    }
}
// page: 0~7，对应OLED8行文字
void OLED_ClearLine(uint8_t page)
{
    uint8_t i;
    OLED_SetPos(0, page);
    for(i=0;i<128;i++)
    {
        OLED_Write_Data(0x00); 
    }
	OLED_SetPos(0, page+1);  
    for(i=0;i<128;i++)
    {
        OLED_Write_Data(0x00); 
    }
}

void OLED_ClearShowString(uint8_t x,uint8_t y,char *str)
{
	OLED_ClearLine(y);
	OLED_ShowString(x,y,str);
}